## conf/layer.conf
```bitbake
# We have a conf and classes directory, add to BBPATH
BBPATH .= ":${LAYERDIR}"
# We have recipes-* directories, add to BBFILES
BBFILES += "${LAYERDIR}/recipes-*/*/*.bb \
            ${LAYERDIR}/recipes-*/*/*.bbappend"

BBFILE_COLLECTIONS += "hovergames"
BBFILE_PATTERN_hovergames = "^${LAYERDIR}/"
LAYERSERIES_COMPAT_hovergames = "sumo"
```

## meta-hovergames-distro/conf/distro/imx-desktop-xwayland.conf
```bitbake
require conf/distro/poky.conf

#include conf/distro/include/fsl-imx-base.inc
#include conf/distro/include/fsl-imx-preferred-env.inc

DISTRO = "imx-desktop-xwayland"

# Remove conflicting backends
DISTRO_FEATURES_remove = "directfb "
DISTRO_FEATURES_append = " x11 wayland pam"

DISTRO_NAME = "Desktop Experience BSP"
DISTRO_VERSION = "1.0"
SDK_VENDOR = "-fslbsp"

TARGET_VENDOR = "-fsl"

SDK_NAME_PREFIX = "${DISTRO}"
SDK_NAME = "${DISTRO}-${TCLIBC}-${SDK_ARCH}-${TUNE_PKGARCH}"

POKY_DEFAULT_DISTRO_FEATURES_remove = " ptest"
DISTRO_FEATURES_DEFAULT_append = " benchmark vfat ext2 mtd \
    perl python usbhost virtualization pam polkit"

# disable network check to support offline build with sdk iso
CONNECTIVITY_CHECK_URIS = ""

# whiteliste restricted license
LICENSE_FLAGS_WHITELIST = "non-commercial_netperf commercial_lame"

#DISTRO_FEATURES_DEFAULT_append = " pam polkit"

# Given the layers we use, we have qemu and qemu-qoriq which are
# not yet synchronized into one. ALB historically has used qemu
# and all  the necessary pathces are there.
PREFERRED_PROVIDER_qemu = "qemu"

# TODO zeus: does not exist
# ignore glibc bbapend form meta-qoriq-demos: it triggers a conflict with
# latest poky/sumo branch for glibc
#BBMASK += "meta-qoriq-demos/recipes-core/glibc/glibc_2.27.bbappend"

IMAGE_CLASSES += "image_types_fsl_flashimage"

# UBI FS support
MKUBIFS_ARGS = "-m 512 -e 15360 -c 12000"
UBINIZE_ARGS = "-m 512 -p 16KiB -s 512"
```

## meta-hovergames-distro/conf/machine/imx8mmevkubuntu.conf
```bitbake
MACHINE="imx8mmevk"
require conf/machine/imx8mmevk.conf

require conf/machine/include/ubuntubasics.inc

KERNEL_DEVICETREE_imx8mmevk = "freescale/imx8mm-evk.dtb"

# not required for ubuntu
IMAGE_CLASSES_remove += "image_types_fsl_flashimage"
IMAGE_FSTYPES_remove += "flashimage"
```

## meta-hovergames-distro/conf/machine/imx8mmnavqddr4ubuntu.conf
```bitbake
MACHINE="imx8mmnavqddr4"
require conf/machine/imx8mmnavqddr4.conf

require conf/machine/include/ubuntubasics.inc

KERNEL_DEVICETREE_imx8mmnavqddr4 = "freescale/imx8mm-navq-ddr4.dtb"

# not required for ubuntu
IMAGE_CLASSES_remove += "image_types_fsl_flashimage"
IMAGE_FSTYPES_remove += "flashimage"
```

## meta-hovergames-distro/conf/machine/imx8mmnavqubuntu.conf
```bitbake
MACHINE="imx8mmnavq"
require conf/machine/imx8mmnavq.conf

require conf/machine/include/ubuntubasics.inc

KERNEL_DEVICETREE_imx8mmnavq = "freescale/imx8mm-navq.dtb \
                                freescale/imx8mm-navq-tof-a65.dtb \
                                "

# not required for ubuntu
IMAGE_CLASSES_remove += "image_types_fsl_flashimage"
IMAGE_FSTYPES_remove += "flashimage"
```

## meta-hovergames-distro/conf/machine/imx8mnevkubuntu.conf
```bitbake
MACHINE="imx8mnevk"
require conf/machine/imx8mnevk.conf

require conf/machine/include/ubuntubasics.inc

KERNEL_DEVICETREE = "freescale/imx8mn-evk.dtb"

# not required for ubuntu
IMAGE_CLASSES_remove += "image_types_fsl_flashimage"
IMAGE_FSTYPES_remove += "flashimage"
```

## meta-hovergames-distro/conf/machine/imx8mqevkubuntu.conf
```bitbake
MACHINE="imx8mqevk"
require conf/machine/imx8mqevk.conf

require conf/machine/include/ubuntubasics.inc

KERNEL_DEVICETREE_imx8mqevk = "freescale/imx8mq-evk.dtb"

# not required for ubuntu
IMAGE_CLASSES_remove += "image_types_fsl_flashimage"
IMAGE_FSTYPES_remove += "flashimage"
```

## meta-hovergames-distro/conf/machine/imx8qmmekubuntu.conf
```bitbake
MACHINE="imx8qmmek"
require conf/machine/imx8qmmek.conf

require conf/machine/include/ubuntubasics.inc

KERNEL_DEVICETREE_imx8qmmek = "freescale/imx8qm-mek.dtb"

# not required for ubuntu
IMAGE_CLASSES_remove += "image_types_fsl_flashimage"
IMAGE_FSTYPES_remove += "flashimage"
```

## meta-hovergames-distro/conf/machine/imx8qxpmekubuntu.conf
```bitbake
MACHINE="imx8qxpmek"
require conf/machine/imx8qxpmek.conf

require conf/machine/include/ubuntubasics.inc

KERNEL_DEVICETREE_imx8qxpmek = "freescale/imx8qxp-mek.dtb"

# not required for ubuntu
IMAGE_CLASSES_remove += "image_types_fsl_flashimage"
IMAGE_FSTYPES_remove += "flashimage"
```

## meta-hovergames/conf/machine/imx8mmnavqddr4.conf
```bitbake
#@TYPE: Machine
#@NAME: NXP i.MX 8M Mini NavQ board with DDR4 memory
#@SOC: i.MX8MM
#@DESCRIPTION: Machine configuration for NXP i.MX 8M Mini NavQ board with DDR4 memory
#@MAINTAINER: Jun Zhu <junzhu@nxp.com>

MACHINEOVERRIDES =. "mx8:mx8m:mx8mm:"

require conf/machine/include/imx-base.inc
require conf/machine/include/tune-cortexa53.inc

MACHINE_FEATURES += "pci wifi bluetooth optee qca9377 bcm43455 bcm4356 bcm4359 jailhouse"

KERNEL_DEVICETREE = "freescale/imx8mm-navq-ddr4.dtb"

WKS_FILE_DEPENDS += "imx-m4-demos"
IMAGE_BOOT_FILES += " \
    imx8mm_m4_TCM_hello_world.bin \
    imx8mm_m4_TCM_rpmsg_lite_pingpong_rtos_linux_remote.bin \
    imx8mm_m4_TCM_rpmsg_lite_str_echo_rtos.bin \
    imx8mm_m4_TCM_sai_low_power_audio.bin \
"

UBOOT_CONFIG ??= "sd"
UBOOT_CONFIG[sd] = "imx8mm_navq_ddr4_config,sdcard"

SPL_BINARY = "spl/u-boot-spl.bin"

# Set DDR FIRMWARE
DDR_FIRMWARE_NAME = " \
    ddr4_imem_1d.bin \
    ddr4_dmem_1d.bin \
    ddr4_imem_2d.bin \
    ddr4_dmem_2d.bin \
"

# Set u-boot DTB
UBOOT_DTB_NAME = "imx8mm-navq-ddr4.dtb"

# Set imx-mkimage boot target
IMXBOOT_TARGETS = "flash_navq_ddr4"

# Set Serial console
SERIAL_CONSOLES = "115200;ttymxc1"

IMAGE_BOOTLOADER = "imx-boot"

LOADADDR = ""
IMX_BOOT_SEEK = "33"
```
